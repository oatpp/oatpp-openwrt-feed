## oatpp-libressl/Config.in
```kconfig
menu "Build/Install Configuration"
	depends on PACKAGE_oatpp-libressl

config OATPP_LIBRESSL_INSTALL_TEST_BIN
	bool "Install Oat++-LibreSSL test binary"
	depends on PACKAGE_oatpp-libressl
	depends on OATPP_INSTALL_TEST_LIB
	default n

endmenu
```

## oatpp-mbedtls/Config.in
```kconfig
menu "Build/Install Configuration"
	depends on PACKAGE_oatpp-mbedtls

config OATPP_MBEDTLS_INSTALL_TEST_BIN
	bool "Install Oat++-mbedtls test binary"
	depends on PACKAGE_oatpp-mbedtls
	depends on OATPP_INSTALL_TEST_LIB
	default n

endmenu
```

## oatpp-swagger/Config.in
```kconfig
menu "Build/Install Configuration"
	depends PACKAGE_oatpp-swagger

	config OATPP_SWAGGER_INSTALL_UI
		bool "Install Swagger UI"
		depends on PACKAGE_oatpp-swagger
		default y

	config OATPP_SWAGGER_INSTALL_TEST_BIN
		bool "Install Oat++-swagger test binary"
		depends on PACKAGE_oatpp-swagger
		depends on OATPP_INSTALL_TEST_LIB
		default n

endmenu
```

## oatpp-websocket/Config.in
```kconfig
menu "Build/Install Configuration"
	depends on PACKAGE_oatpp-websocket

config OATPP_WEBSOCKET_INSTALL_TEST_BIN
	bool "Install Oat++-websocket test binary"
	depends on PACKAGE_oatpp-websocket
	depends on OATPP_INSTALL_TEST_LIB
	default n

endmenu
```

## oatpp/Config.in
```kconfig
menu "Build/Install Configuration"
	depends on PACKAGE_oatpp

	choice OATPP_BUILD_TYPE
		depends on PACKAGE_oatpp
		prompt "Build Static or Shared"
		default OATPP_BUILD_TYPE_STATIC

		config OATPP_BUILD_TYPE_STATIC
			bool "Static"

		config OATPP_BUILD_TYPE_SHARED
			bool "Shared"

	endchoice

	config OATPP_SYMLINK_LIB
		bool "Symlink Oat++-Libs to /usr/lib"
		default y
		help
		  Oat++ is installed to /usr/lib/oatpp-<version>/oatpp.so
		  Say yes here to symlink /usr/lib/oatpp.so.<verion> to /usr/lib/oatpp-<version>/oatpp.so

	config OATPP_INSTALL_TEST_LIB
		bool "Install Oat++ test library"
		default n

	config OATPP_INSTALL_TEST_BIN
		bool "Install Oat++ test binary"
		depends on OATPP_INSTALL_TEST_LIB
		default n

endmenu
```
